## firmware/esp32-mmwave-node/sdkconfig.defaults
```kconfig
CONFIG_PARTITION_TABLE_CUSTOM=y
CONFIG_PARTITION_TABLE_CUSTOM_FILENAME="partitions.csv"
CONFIG_ESPTOOLPY_FLASHSIZE_4MB=y
CONFIG_ESP_CONSOLE_USB_SERIAL_JTAG=y
CONFIG_ESP_CONSOLE_SECONDARY_NONE=y
CONFIG_BOOTLOADER_APP_ROLLBACK_ENABLE=y
CONFIG_ESP_SYSTEM_PANIC_PRINT_REBOOT=y
CONFIG_LWIP_SNTP_MAX_SERVERS=1
CONFIG_MBEDTLS_HARDWARE_AES=y
```

## software/ruview/firmware/esp32-csi-node/sdkconfig.defaults.rx-raw
```kconfig
# Opt-in ESP32-S3 raw-RX baseline overlay. Not selected by normal builds.
# Combine after sdkconfig.defaults via SDKCONFIG_DEFAULTS.
CONFIG_IDF_TARGET="esp32s3"
CONFIG_CSI_RAW_PROFILE=y
CONFIG_EDGE_TIER=0
CONFIG_CSI_SELF_PING_ENABLE=y
CONFIG_CSI_CAPTURE_RATE_LIMIT_HZ=50
CONFIG_CSI_TRANSPORT_CAPTURE_SLOTS=8
CONFIG_CSI_TRANSPORT_TASK_STACK_BYTES=8192
CONFIG_CSI_TRANSPORT_TASK_PRIORITY=5
CONFIG_CSI_TRANSPORT_TASK_CORE=-1
CONFIG_ESP_DEFAULT_CPU_FREQ_MHZ_160=y
CONFIG_COMPILER_OPTIMIZATION_SIZE=y
```

## software/ruview/firmware/esp32-csi-node/sdkconfig.defaults.rx-unified
```kconfig
# Shared S3 measurement image. Device identity, board and topology live in NVS.
# Apply after sdkconfig.defaults; never use an existing per-device sdkconfig.
CONFIG_RX_UNIFIED=y
CONFIG_CSI_RAW_PROFILE=y
CONFIG_CSI_FRAME_HE_TAGGING=y
CONFIG_CSI_NODE_ID=0
CONFIG_CSI_WIFI_SSID=""
CONFIG_CSI_WIFI_PASSWORD=""
CONFIG_CSI_TARGET_IP="0.0.0.0"
CONFIG_EDGE_TIER=0
CONFIG_CSI_SELF_PING_ENABLE=y
CONFIG_CSI_SELF_PING_INTERVAL_MS=20
CONFIG_CSI_SELF_PING_TIMEOUT_MS=1000
CONFIG_CSI_CAPTURE_RATE_LIMIT_HZ=50
CONFIG_CSI_TRANSPORT_CAPTURE_SLOTS=8
CONFIG_CSI_TRANSPORT_TASK_STACK_BYTES=8192
CONFIG_CSI_TRANSPORT_TASK_PRIORITY=5
CONFIG_CSI_TRANSPORT_TASK_CORE=-1
CONFIG_ESP_DEFAULT_CPU_FREQ_MHZ_240=y
CONFIG_COMPILER_OPTIMIZATION_PERF=y
CONFIG_APP_REPRODUCIBLE_BUILD=y
CONFIG_HEAP_POISONING_COMPREHENSIVE=y
CONFIG_FREERTOS_CHECK_STACKOVERFLOW_CANARY=y
CONFIG_COMPILER_STACK_CHECK_MODE_STRONG=y
CONFIG_FREERTOS_USE_TRACE_FACILITY=y
CONFIG_FREERTOS_GENERATE_RUN_TIME_STATS=y
CONFIG_FREERTOS_RUN_TIME_STATS_USING_ESP_TIMER=y
CONFIG_FREERTOS_RUN_TIME_COUNTER_TYPE_U64=y
CONFIG_WASM_ENABLE=n
CONFIG_DISPLAY_ENABLE=n
```

## software/ruview/firmware/esp32-csi-tx/main/Kconfig.projbuild
```kconfig
menu "TX migration"
    config TX_PROTECT_ORIGINAL_APP
        bool "Preserve the original app0 (reject OTA targeting it)"
        default y
    config TX_VERIFIED_ROLLBACK
        bool "Bootloader rollback and shared-data compatibility verified externally"
        depends on BOOTLOADER_APP_ROLLBACK_ENABLE
        default n
endmenu
```

## software/ruview/firmware/esp32-csi-tx/sdkconfig.defaults
```kconfig
CONFIG_IDF_TARGET="esp32s3"
CONFIG_ESPTOOLPY_FLASHSIZE_4MB=y
CONFIG_APP_REPRODUCIBLE_BUILD=y
# UART0 retains early/panic output while native USB reenumerates after reset.
CONFIG_ESP_CONSOLE_UART_DEFAULT=y
CONFIG_ESP_CONSOLE_SECONDARY_USB_SERIAL_JTAG=y
CONFIG_ESP_SYSTEM_PANIC_PRINT_REBOOT=y
CONFIG_ESP_SYSTEM_PANIC_REBOOT_DELAY_SECONDS=3
# Main's radio/getter/logging call chain overflowed the 3584-byte default.
CONFIG_ESP_MAIN_TASK_STACK_SIZE=8192
CONFIG_PARTITION_TABLE_CUSTOM=y
CONFIG_PARTITION_TABLE_CUSTOM_FILENAME="partitions.csv"
CONFIG_BOOTLOADER_APP_ROLLBACK_ENABLE=n
CONFIG_BOOTLOADER_APP_ANTI_ROLLBACK=n
CONFIG_SECURE_BOOT=n
CONFIG_SECURE_FLASH_ENC_ENABLED=n
CONFIG_NVS_ENCRYPTION=n
CONFIG_ESP_WIFI_NVS_ENABLED=n
CONFIG_ESP_PHY_CALIBRATION_AND_DATA_STORAGE=n
CONFIG_ESP_PHY_INIT_DATA_IN_PARTITION=n
CONFIG_ESP_PHY_MAX_WIFI_TX_POWER=11
CONFIG_TX_PROTECT_ORIGINAL_APP=y
CONFIG_TX_VERIFIED_ROLLBACK=n
CONFIG_ESP_TASK_WDT_EN=y
CONFIG_ESP_TASK_WDT_INIT=y
CONFIG_ESP_TASK_WDT_TIMEOUT_S=10
CONFIG_COMPILER_OPTIMIZATION_SIZE=y
CONFIG_HTTPD_MAX_REQ_HDR_LEN=1024
```

## software/ruview/firmware/esp32-mmwave-node/main/Kconfig.projbuild
```kconfig
menu "RuView mmWave node"

config MMWAVE_WIFI_SSID
    string "WiFi SSID"
    default ""

config MMWAVE_WIFI_PASSWORD
    string "WiFi password"
    default ""

config MMWAVE_TARGET_HOST
    string "UDP collector IPv4 address"
    default "192.0.2.50"

config MMWAVE_TARGET_PORT
    int "UDP collector port"
    range 1 65535
    default 5010

config MMWAVE_STREAM_INTERVAL_MS
    int "Minimum interval between radar UDP packets (ms)"
    range 20 1000
    default 50
    help
        Lower values reduce the spacing between measurements when the radar
        produces frames faster than the collector. 50 ms is the low-latency
        default; the actual rate is still limited by the LD2450 UART stream.

config MMWAVE_WIFI_PS_NONE
    bool "Disable WiFi modem sleep for low-latency radar"
    default y
    help
        Disable modem sleep so received UDP frames are not held until a DTIM
        wake-up. This increases power use, but is the preferred setting for a
        mains-powered sensor where measurement latency matters.

config MMWAVE_UDP_ACK_ATTEMPTS
    int "Maximum UDP delivery attempts per radar frame"
    range 1 8
    default 8
    help
        Retry the same sequence until the collector acknowledges it. Retries
        are bounded so a disconnected collector cannot block the UART task
        indefinitely.

config MMWAVE_UDP_ACK_TIMEOUT_MS
    int "Collector ACK timeout (ms)"
    range 5 100
    default 50

config MMWAVE_NODE_ID
    string "Stable node ID"
    default "MMWAVE1"

config MMWAVE_OTA_PSK
    string "OTA and mode-control bearer token"
    default ""
    help
        Required for OTA uploads and mode changes. Keep this secret.
        Empty means that all mutating HTTP endpoints fail closed.

config MMWAVE_INITIAL_MODE_CALIBRATION
    bool "Start in calibration mode on a fresh NVS partition"
    default y

config MMWAVE_RADAR_ORIGIN_X_MM
    int "Radar origin X in room coordinates (mm)"
    default 0

config MMWAVE_RADAR_ORIGIN_Z_MM
    int "Radar origin Z in room coordinates (mm)"
    default 0

config MMWAVE_RADAR_YAW_MDEG
    int "Radar forward-axis yaw from room +X (millidegrees)"
    range -360000 360000
    default 0

config MMWAVE_RADAR_INVERT_RAW_X
    bool "Invert raw radar X before treating it as local-right"
    default n
    help
        Determine this with measured left/right floor marks after mounting.

endmenu
```

## software/ruview/firmware/esp32-mmwave-node/tools/ap_probe/main/Kconfig.projbuild
```kconfig
menu "MMWAVE2 AP diagnosis"
config AP_PROBE_PASSWORD
    string "Private WPA2 test password (8-63 characters)"
    default ""
config AP_PROBE_CHANNEL
    int "AP channel"
    range 1 11
    default 1
config AP_PROBE_TX_POWER
    int "Maximum TX power in quarter dBm (78 = driver default maximum)"
    range 8 78
    default 78
endmenu
```

## software/ruview/firmware/esp32-mmwave-node/tools/ap_probe/sdkconfig.defaults
```kconfig
CONFIG_IDF_TARGET="esp32c3"
CONFIG_ESPTOOLPY_FLASHSIZE_4MB=y
CONFIG_PARTITION_TABLE_CUSTOM=y
CONFIG_PARTITION_TABLE_CUSTOM_FILENAME="partitions.csv"
CONFIG_BOOTLOADER_APP_ROLLBACK_ENABLE=y
CONFIG_ESP_CONSOLE_USB_SERIAL_JTAG=y
```
